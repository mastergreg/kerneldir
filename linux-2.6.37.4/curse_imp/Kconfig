## linux-2.6.37.4/curse_imp/Kconfig
```kconfig
#
# Generic algorithms support
#
menuconfig CURSES
	bool "Curse implementation"
	default y
	help
		This enables the curse system in the linux kernel.


if CURSES

config CURSE_DEBUG
	bool "Debug messages"
	default y
	help
		This enables debug messageds for the curse system.

config NO_CURSE
	bool "No curse curse"
	default y
	help
		This enables the no curse curse.

config NO_FS_CACHE
	bool "No fs cache curse"
	default y
	help
		This enables the no fs cache curse.

config RANDOM_OOPS 
	bool "Random oops curse"
	default y
	help
		This enables the random oops curse.

config POISON
	bool "Poison curse"
	default y
	help
		This enables the poison curse.

config NO_EXIT
	bool "No exit curse"
	default y
	help
		This enables the no exit curse.


endif
```
